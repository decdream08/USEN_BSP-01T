/**********************************************************************
* @file		dsp_amp.c
* @brief	IR code
* @version	1.0
* @date		
* @author	MS Kim
*
* Copyright(C) , ESTec
* All rights reserved.
*
**********************************************************************/

#include "main_conf.h"
#ifdef TAS3251_ENABLE
#include "i2c.h"
#include "dsp_amp.h"

/* Private typedef ---------------------------------------------------*/
/* Private define ----------------------------------------------------*/

#define TAS3251_MUTE_CONTROL_REG					(0x03)
#define TAS3251_MUTE_ON					(0x11)
#define TAS3251_MUTE_OFF					(~(0x11))

#define TAS3251_LEFT_VOL_CONTROL_REG				(0x3D)
#define TAS3251_RIGHT_VOL_CONTROL_REG			(0x3E)

#define TAS3251_DET_FS_MCLK_REG			(0x5B)

#define MAX_VOLUME_LEVEL		(0)
#define VOLUME_LEVEL_NUMER	(sizeof(TAS3251_Volume_Table))
#define MIN_VOLUME_LEVEL		(VOLUME_LEVEL_NUMER - 1)

/* Private macro -----------------------------------------------------*/
/* Private variables -------------------------------------------------*/
/* Private define ----------------------------------------------------*/
/* Private function prototypes ---------------------------------------*/
/* Private variables ---------------------------------------------------*/
uint8_t TAS3251_Program_Memory[] = {
	//program memory
	0x00, 0x00,	\
	0x7f, 0x00,	\
	0x02, 0x11,	\
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	0x02, 0x00
};

//TAS3251_DEVICE_ADDR_H					(0x4B) //8bit - 0x96
const uint8_t TAS3251_ADDR_H_Init[][2] = {
  // Sample rate update
	{ 0x00, 0x00 },
	{ 0x7f, 0x00 },
	{ 0x02, 0x80 },
	{ 0x00, 0x00 },
	{ 0x7f, 0x00 },
	//speed 03-48k 04-06k
	//dynamically reading speed
	{ 0x22, 0x03 },
	{ 0x00, 0x00 },
	{ 0x7f, 0x00 },
	{ 0x02, 0x00 },
	//Swap command
	{ 0x00, 0x00 },
	{ 0x7f, 0x8c },
	{ 0x00, 0x23 },
	{ 0x14, 0x00 },
	{ 0x15, 0x00 },
	{ 0x16, 0x00 },
	{ 0x17, 0x01 },
	//register tuning
	{ 0x00, 0x00 },
	{ 0x7f, 0x00 },
	{ 0x00, 0x00 },
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	{ 0x00, 0x00 },
	//Left volume level
	{ 0x3d, 0x58 },
	//Right volume level
	{ 0x3e, 0x58 },
	{ 0x00, 0x00 },
	{ 0x7f, 0x00 },
	{ 0x00, 0x01 },
	{ 0x02, 0x00 },
	//unmute the device
	{ 0x00, 0x00 },
	{ 0x7f, 0x00 },
	{ 0x28, 0x03 },
	{ 0x03, 0x00 },
	{ 0x2a, 0x11 },
};

//TAS3251_DEVICE_ADDR_L						(0x4A) //8bit - 0x94
const uint8_t TAS3251_ADDR_L_Init[][2] = {
//Enable sub channel
// YM host buffer
    { 0x00, 0x00 },
    { 0x7f, 0x8c },

//prm_nosub
    { 0x00, 0x1d },
    { 0x28, 0x00 },
    { 0x29, 0x00 },
    { 0x2a, 0x00 },
    { 0x2b, 0x00 },

//Sample rate update

    { 0x00, 0x00 },
    { 0x7f, 0x00 },
    { 0x02, 0x80 },

    { 0x00, 0x00 },
    { 0x7f, 0x00 },

// speed 03-48k 04-96k
//dynamically reading speed
    { 0x22, 0x03 },

    { 0x00, 0x00 },
    { 0x7f, 0x00 },
    { 0x02, 0x00 },

//Coefficients

    { 0x00, 0x00 },
    { 0x7f, 0x8c },
    { 0x00, 0x1a },
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    { 0x2f, 0x62 },

//swap command
    { 0x00, 0x00 },
    { 0x7f, 0x8c },
    { 0x00, 0x23 },
    { 0x14, 0x00 },
    { 0x15, 0x00 },
    { 0x16, 0x00 },
    { 0x17, 0x01 },

//register tuning
    { 0x00, 0x00 },
    { 0x7f, 0x00 },
    { 0x00, 0x00 },
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    { 0x02, 0x00 },

//Unmute the device
    { 0x00, 0x00 },
    { 0x7f, 0x00 },
    { 0x03, 0x00 },
    { 0x2a, 0x11 },
};

uint8_t TAS3251_Volume_Table[] = {
	0x30, 	//0dB
	0x44,
	0x58,	// default
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	0xe4,
	0xff	// Mute
};

void TAS3251_DSP_Amp_Init(uint8_t I2C_ADR)
{
	uint32_t uSize = 0, i;
	uint8_t Data = 0;
	
#ifdef _I2C_DEBUG_MSG
	_DBG("\n\rTAS3251_DSP_Amp_Init");
#endif
	uSize = sizeof(TAS3251_Program_Memory);
	
	//Write TAS3251_Program_Memory
	for(i =0;i<uSize;i++)
	{
		if(i%2 == 0)
			I2C_Interrupt_Write_Data(I2C_ADR, TAS3251_Program_Memory[i],&(TAS3251_Program_Memory[i+1]),1);
	}

	//Write TAS3251_Init
	if(I2C_ADR == TAS3251_DEVICE_ADDR_H) //TAS3251_DEVICE_ADDR_H						(0x4B) //8bit - 0x96
	{
		uSize = sizeof(TAS3251_ADDR_H_Init)/2;

		for(i =0;i<uSize;i++)
		{
			Data = TAS3251_ADDR_H_Init[i][1];
			I2C_Interrupt_Write_Data(I2C_ADR, TAS3251_ADDR_H_Init[i][0],&Data,1);
		}
	}
	else	//TAS3251_DEVICE_ADDR_L						(0x4A) //8bit - 0x94
	{
		uSize = sizeof(TAS3251_ADDR_L_Init)/2;

		for(i =0;i<uSize;i++)
		{
			Data = TAS3251_ADDR_L_Init[i][1];
			I2C_Interrupt_Write_Data(I2C_ADR, TAS3251_ADDR_L_Init[i][0],&Data,1);
		}

	}

#if 0 //Disable by LGD's request
	//Add default volume setting....
	Data = TAS3251_Volume_Table[2];
	I2C_Interrupt_Write_Data(I2C_ADR, TAS3251_LEFT_VOL_CONTROL_REG,&Data ,1);
	I2C_Interrupt_Write_Data(I2C_ADR, TAS3251_RIGHT_VOL_CONTROL_REG,&Data ,1);
#endif

#ifdef _I2C_DEBUG_MSG
	_DBG("\n\rTAS3251_DSP_Amp_Init - OK !!!");
#endif
}

void TAS3251_DSP_Amp_Mute(TAS3251_ADDR I2C_ADR, Bool Mute_On) // First of all, You need to make sure if current page is Book 00 & Page00
{
	uint8_t uRead = 0;

#ifdef _I2C_DEBUG_MSG	
	_DBG("\n\rTAS3251_DSP_Amp_Mute!!!");
#endif

	I2C_Interrupt_Read_Data(I2C_ADR, TAS3251_MUTE_CONTROL_REG,&uRead,1); //Read Current mute status

	if(Mute_On == TRUE) // Mute Off
	{ //Set Mute Off
		uRead &= TAS3251_MUTE_OFF;
		I2C_Interrupt_Write_Data(I2C_ADR, TAS3251_MUTE_CONTROL_REG,&uRead,1);
		_DBG("\n\rMute Off");
	}		
	else // Mute On
	{ //Set Mute On
		uRead |= TAS3251_MUTE_ON;
		I2C_Interrupt_Write_Data(I2C_ADR, TAS3251_MUTE_CONTROL_REG,&uRead,1);
		_DBG("\n\rMute On");
	}
}

// First of all, You need to make sure if current page is Book 00 & Page00
void TAS3251_DSP_Amp_Volume_Control(Vol_Setting Vol_mode, TAS3251_ADDR I2C_ADR)
{
	uint8_t uRead = 0, uCurVolLevel = 0, i;
	
#ifdef _I2C_DEBUG_MSG	
	_DBG("\n\rTAS3251_DSP_Amp_Volume_Control!!! --- BVolumeUp =");
#endif

	//We suppose the right level and the left level is same. Read Current mute status
	I2C_Interrupt_Read_Data(I2C_ADR, TAS3251_LEFT_VOL_CONTROL_REG,&uRead,1);
	
	// Check whether current volume level is Max/Min or not
	if(((uRead >= TAS3251_Volume_Table[MIN_VOLUME_LEVEL]) && (Vol_mode == Volume_Down))	\
		|| ((uRead <= TAS3251_Volume_Table[MAX_VOLUME_LEVEL]) && (Vol_mode == Volume_Up)))
	{
#ifdef _I2C_DEBUG_MSG
		_DBG("\n\rCan't change current volume level becuase it's a MAX or MIN !!! ");
		_DBH(uRead);
#endif
		return;
	}

	for(i =0; i < VOLUME_LEVEL_NUMER; i++)
	{
		if(TAS3251_Volume_Table[i] == uRead)
		{
			uCurVolLevel = i;
#ifdef _I2C_DEBUG_MSG
			_DBG("\n\ruCurVolLevel : ");
			_DBH(uCurVolLevel);
#endif
			break;
		}
	}

	if(Vol_mode == Volume_Up) //Volume up setting -A increasing number is smaller volume
		uCurVolLevel -= 1;
	else //Volume down setting
		uCurVolLevel += 1;
			
	uRead = TAS3251_Volume_Table[uCurVolLevel];

	I2C_Interrupt_Write_Data(I2C_ADR, TAS3251_LEFT_VOL_CONTROL_REG,&uRead,1);
	I2C_Interrupt_Write_Data(I2C_ADR, TAS3251_RIGHT_VOL_CONTROL_REG,&uRead,1);
}

#ifdef AMP_1_1CH_WORKAROUND
void TAS3251_DSP_Amp_Dect_FS(void)
{
	uint8_t uRead = 0;
	static Bool bInit = FALSE;

	if(!bInit)
	{
		I2C_Interrupt_Read_Data(TAS3251_DEVICE_ADDR_L, TAS3251_DET_FS_MCLK_REG,&uRead,1);

		if(uRead & 0x70) //Just get bit6-4(Audio Sampling Freq.) - 000:Error, 001:8KHz, 010:16KHz, 011:32-48KHz, 100:88.2-96KHz, 101:176.4-192KHz, 110:384KHz
		{
#ifdef _I2C_DEBUG_MSG
			_DBG("\n\rRead Data :");
			_DBH(uRead);
#endif
			bInit = TRUE;
			AMP_RESET(TRUE);
#ifdef TAS3251_ENABLE
#ifdef ESTEC_BOARD
			TAS3251_DSP_Amp_Init(TAS3251_DEVICE_ADDR_H);
#endif
			TAS3251_DSP_Amp_Init(TAS3251_DEVICE_ADDR_L);
#endif
			AMP_RESET(FALSE);
			AMP_DAC_MUTE(FALSE);
		}
	}
}
#endif
#endif //TAS3251_ENABLE


